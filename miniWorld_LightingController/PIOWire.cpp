/*
    PIOWire - see PIOWire.h

    Invector Embedded Systems AB
*/

#include "PIOWire.h"

#include <hardware/clocks.h>
#include <hardware/gpio.h>

#include "i2c.pio.h"        // generated by pioasm from pico-examples i2c.pio

extern "C" {
#include "pio_i2c.h"        // pico-examples pio/i2c
}

// ---------------------------------------------------------------------------
// PIO instance and program bookkeeping, shared by every PIOWire object.
// One copy of the program per PIO block, shared by the 4 SMs in that block.
// ---------------------------------------------------------------------------

static PIO _pioList[] = {
    pio0, pio1
#if NUM_PIOS > 2
    , pio2
#endif
};

static int _pgmOffset[NUM_PIOS];
static bool _pgmTableInit = false;

// ---------------------------------------------------------------------------

PIOWire::PIOWire(pin_size_t sda, pin_size_t scl) : _sda(sda), _scl(scl) {
}

PIOWire::~PIOWire() {
    end();
}

bool PIOWire::setSDA(pin_size_t pin) {
    if (_running) {
        return false;
    }
    _sda = pin;
    return true;
}

bool PIOWire::setSCL(pin_size_t pin) {
    if (_running) {
        return false;
    }
    _scl = pin;
    return true;
}

float PIOWire::clkdivFor(uint32_t freq) const {
    // The PIO program consumes 32 cycles per bit period.
    return (float)clock_get_hz(clk_sys) / (32.0f * (float)freq);
}

bool PIOWire::allocate() {
    if (!_pgmTableInit) {
        for (uint i = 0; i < NUM_PIOS; i++) {
            _pgmOffset[i] = -1;
        }
        _pgmTableInit = true;
    }

    for (uint i = 0; i < NUM_PIOS; i++) {
        PIO p = _pioList[i];

        // If this block does not hold the program yet, make sure it will fit
        // before we claim an SM we might have to give back.
        if (_pgmOffset[i] < 0 && !pio_can_add_program(p, &i2c_program)) {
            continue;
        }

        int sm = pio_claim_unused_sm(p, false);
        if (sm < 0) {
            continue;
        }

        if (_pgmOffset[i] < 0) {
            _pgmOffset[i] = pio_add_program(p, &i2c_program);
        }

        _pio = p;
        _sm = sm;
        _offset = _pgmOffset[i];
        return true;
    }

    return false;
}

void PIOWire::smInit() {
    pio_sm_config c = i2c_program_get_default_config(_offset);

    // SDA is reached through out/set/in/jmp, SCL through side-set. These are
    // separate selectors, hence no adjacency requirement.
    sm_config_set_out_pins(&c, _sda, 1);
    sm_config_set_set_pins(&c, _sda, 1);
    sm_config_set_in_pins(&c, _sda);
    sm_config_set_sideset_pins(&c, _scl);
    sm_config_set_jmp_pin(&c, _sda);

    sm_config_set_out_shift(&c, false, true, 16);
    sm_config_set_in_shift(&c, false, true, 8);
    sm_config_set_clkdiv(&c, clkdivFor(_freq));

    // Bring the IOs up without glitching the bus: park them high, then hand
    // them to the PIO, then invert OE so that the pin is driven low only when
    // the PIO asserts OE, and released to the pull-up otherwise.
    const uint32_t mask = (1u << _sda) | (1u << _scl);
    pio_sm_set_pins_with_mask(_pio, _sm, mask, mask);
    pio_sm_set_pindirs_with_mask(_pio, _sm, mask, mask);

    pio_gpio_init(_pio, _sda);
    pio_gpio_init(_pio, _scl);
    gpio_pull_up(_sda);
    gpio_pull_up(_scl);
    gpio_set_oeover(_sda, GPIO_OVERRIDE_INVERT);
    gpio_set_oeover(_scl, GPIO_OVERRIDE_INVERT);

    pio_sm_set_pins_with_mask(_pio, _sm, 0, mask);

    // Clear any stale error flag and keep it off the system interrupt lines.
    _pio->irq = (1u << _sm);
    pio_set_irq0_source_enabled(_pio, (pio_interrupt_source)(pis_interrupt0 + _sm), false);
    pio_set_irq1_source_enabled(_pio, (pio_interrupt_source)(pis_interrupt0 + _sm), false);

    pio_sm_init(_pio, _sm, _offset + i2c_offset_entry_point, &c);
    pio_sm_set_enabled(_pio, _sm, true);
}

void PIOWire::begin() {
    if (_running) {
        return;
    }
    if (_sda > 29 || _scl > 29 || _sda == _scl) {
        return;
    }
    if (!allocate()) {
        return;     // no free state machine or no room for the program
    }
    smInit();
    _running = true;
}

void PIOWire::begin(uint8_t address) {
    (void)address;
    // Slave mode is not implemented. Use the hardware Wire/Wire1 for that.
}

void PIOWire::end() {
    if (!_running) {
        return;
    }
    pio_sm_set_enabled(_pio, _sm, false);
    pio_sm_unclaim(_pio, _sm);

    gpio_set_oeover(_sda, GPIO_OVERRIDE_NORMAL);
    gpio_set_oeover(_scl, GPIO_OVERRIDE_NORMAL);
    gpio_set_function(_sda, GPIO_FUNC_SIO);
    gpio_set_function(_scl, GPIO_FUNC_SIO);
    gpio_set_dir(_sda, GPIO_IN);
    gpio_set_dir(_scl, GPIO_IN);

    // Note: the program is intentionally left loaded in the block. Removing it
    // would break any other PIOWire sharing the same offset.
    _pio = nullptr;
    _sm = -1;
    _offset = -1;
    _running = false;
    _inTx = false;
    _pendingWrite = false;
    _txLen = _rxLen = _rxPos = 0;
}

void PIOWire::setClock(uint32_t freq) {
    _freq = freq;
    if (!_running) {
        return;
    }
    pio_sm_set_enabled(_pio, _sm, false);
    pio_sm_set_clkdiv(_pio, _sm, clkdivFor(_freq));
    pio_sm_clkdiv_restart(_pio, _sm);
    pio_sm_set_enabled(_pio, _sm, true);
}

// ---------------------------------------------------------------------------
// Master transactions
// ---------------------------------------------------------------------------

void PIOWire::beginTransmission(uint8_t address) {
    _addr = address;
    _txLen = 0;
    _inTx = true;
}

uint8_t PIOWire::endTransmission(bool stopBit) {
    if (!_running || !_inTx) {
        return 4;
    }
    _inTx = false;

    if (!stopBit) {
        // Defer the write so that a following requestFrom() can issue it as
        // one combined transaction. See requestFrom() for the caveat.
        _pendingWrite = true;
        return 0;
    }

    int r = pio_i2c_write_blocking(_pio, _sm, _addr, _txBuf, _txLen);
    _txLen = 0;
    return (r < 0) ? 2 : 0;     // 2 = NAK, we cannot tell address from data
}

uint8_t PIOWire::endTransmission() {
    return endTransmission(true);
}

size_t PIOWire::requestFrom(uint8_t address, size_t len, bool stopBit) {
    (void)stopBit;              // this driver is blocking and always stops

    _rxLen = 0;
    _rxPos = 0;

    if (!_running || len == 0) {
        _pendingWrite = false;
        _txLen = 0;
        return 0;
    }
    if (len > PIOWIRE_BUFFER_SIZE) {
        len = PIOWIRE_BUFFER_SIZE;
    }

    if (_pendingWrite) {
        // CAVEAT: this issues STOP then START rather than a true repeated
        // start. Register-pointer devices such as the Semtech SX150x family
        // are happy with that. A device that requires a genuine repeated
        // start needs the low-level pio_i2c primitives instead.
        _pendingWrite = false;
        int w = pio_i2c_write_blocking(_pio, _sm, _addr, _txBuf, _txLen);
        _txLen = 0;
        if (w < 0) {
            return 0;
        }
    }

    if (pio_i2c_read_blocking(_pio, _sm, address, _rxBuf, len) < 0) {
        return 0;
    }

    _rxLen = len;
    return len;
}

size_t PIOWire::requestFrom(uint8_t address, size_t len) {
    return requestFrom(address, len, true);
}

// ---------------------------------------------------------------------------
// Stream / Print
// ---------------------------------------------------------------------------

size_t PIOWire::write(uint8_t data) {
    if (!_inTx || _txLen >= PIOWIRE_BUFFER_SIZE) {
        return 0;
    }
    _txBuf[_txLen++] = data;
    return 1;
}

size_t PIOWire::write(const uint8_t *buf, size_t len) {
    size_t n = 0;
    while (n < len && write(buf[n])) {
        n++;
    }
    return n;
}

int PIOWire::available() {
    return (int)(_rxLen - _rxPos);
}

int PIOWire::read() {
    if (_rxPos >= _rxLen) {
        return -1;
    }
    return _rxBuf[_rxPos++];
}

int PIOWire::peek() {
    if (_rxPos >= _rxLen) {
        return -1;
    }
    return _rxBuf[_rxPos];
}
